
#include <Arduino.h>
#include <WiFi.h>
#include <esp32ModbusTCP.h>

const char* ssid = "GTM_EUROPE_AP";
const char* pass = "deneme123";
bool WiFiConnected = false;

static uint8_t crcHiTable[] = {
  0x00, 0xC1, 0x81, 0x40, 0x01, 0xC0, 0x80, 0x41, 0x01, 0xC0, 0x80, 0x41, 0x00, 0xC1, 0x81,
  0x40, 0x01, 0xC0, 0x80, 0x41, 0x00, 0xC1, 0x81, 0x40, 0x00, 0xC1, 0x81, 0x40, 0x01, 0xC0,
  0x80, 0x41, 0x01, 0xC0, 0x80, 0x41, 0x00, 0xC1, 0x81, 0x40, 0x00, 0xC1, 0x81, 0x40, 0x01,
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  0x00, 0xC1, 0x81, 0x40, 0x01, 0xC0, 0x80, 0x41, 0x01, 0xC0, 0x80, 0x41, 0x00, 0xC1, 0x81,
  0x40
};

static uint8_t crcLoTable[] = {
  0x00, 0xC0, 0xC1, 0x01, 0xC3, 0x03, 0x02, 0xC2, 0xC6, 0x06, 0x07, 0xC7, 0x05, 0xC5, 0xC4,
  0x04, 0xCC, 0x0C, 0x0D, 0xCD, 0x0F, 0xCF, 0xCE, 0x0E, 0x0A, 0xCA, 0xCB, 0x0B, 0xC9, 0x09,
  0x08, 0xC8, 0xD8, 0x18, 0x19, 0xD9, 0x1B, 0xDB, 0xDA, 0x1A, 0x1E, 0xDE, 0xDF, 0x1F, 0xDD,
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  0x44, 0x84, 0x85, 0x45, 0x87, 0x47, 0x46, 0x86, 0x82, 0x42, 0x43, 0x83, 0x41, 0x81, 0x80,
  0x40
};

uint16_t CRC16(uint8_t* msg, size_t len) {
  uint8_t crcHi = 0xFF;
  uint8_t crcLo = 0xFF;
  uint8_t index;

  while (len--) {
    index = crcLo ^ *msg++;
    crcLo = crcHi ^ crcHiTable[index];
    crcHi = crcLoTable[index];
  }
  return (crcHi << 8 | crcLo);
}

esp32ModbusTCP mbt(1, { 192, 168, 4, 2 }, 50200);

void setup() {

  Serial.begin(9600);

  WiFi.disconnect(true);  // delete old config

  mbt.onData([](uint16_t packet, uint8_t slave, esp32Modbus::FunctionCode fc, uint8_t* data, uint16_t len) {
    if (len == 0) {
      len += 3;
    }
    len += 3;
    uint16_t crc = CRC16(data, len);
    Serial.write(data, len);
    Serial.write((uint8_t)(crc & 0xFF));
    Serial.write((uint8_t)((crc >> 8) & 0xFF));
  });
  mbt.onError([](uint16_t packet, esp32Modbus::Error e) {
    //Serial.printf("Error packet %u: %02x\n", packet, e);
  });

  delay(1000);

  WiFi.onEvent([](WiFiEvent_t event, WiFiEventInfo_t info) {
    Serial.print("WiFi connected. IP: ");
    Serial.println(IPAddress(info.got_ip.ip_info.ip.addr));
    WiFiConnected = true;
  },
               WiFiEvent_t::ARDUINO_EVENT_WIFI_STA_GOT_IP);
  WiFi.onEvent([](WiFiEvent_t event, WiFiEventInfo_t info) {
    //Serial.print("WiFi lost connection. Reason: ");
    // Serial.println(info.disconnected.reason);
    WiFi.disconnect();
    WiFiConnected = false;
  },
               WiFiEvent_t::ARDUINO_EVENT_WIFI_STA_DISCONNECTED);

  //WiFi.begin(ssid, pass);

  WiFi.softAP(ssid, pass);

  IPAddress IP = WiFi.softAPIP();
  Serial.print("AP IP address: ");
  Serial.println(IP);    

  delay(2000);
}

uint8_t buffer[255];
uint8_t i = 0;

void loop() {
  //static uint32_t lastMillis = 0;
  // if ((millis() - lastMillis > 3000 && WiFiConnected)) {
  //   lastMillis = millis();
  //   Serial.print("reading registers\n");
  //   for (uint8_t i = 0; i < numberSmaRegisters; ++i) {
  //     uint16_t packetId = sunnyboy.readHoldingRegisters(smaRegisters[i].address, smaRegisters[i].length);
  //     if (packetId > 0) {
  //       smaRegisters[i].packetId = packetId;
  //     } else {
  //       Serial.print("reading error\n");
  //     }
  //   }
  // }

  if (Serial.available() > 0) {    
    i = 0;
    delay(100);
    do {
      buffer[i++] = Serial.read();
    } while (Serial.available());
    i-=2;
    uint16_t crc = CRC16(buffer, i);
    if(((crc & 0xFF)==buffer[i]) &&
    (((crc>>8) & 0xFF)==buffer[i+1]))
    {
      mbt.forwardData(buffer, i);
    }
    else
    {
      Serial.println("CRC hatali...");
    }
  }
}
